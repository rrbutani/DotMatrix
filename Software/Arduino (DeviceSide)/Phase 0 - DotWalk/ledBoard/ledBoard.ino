// phy wire to code translation
/*
       16      15      11      06      10      04      03      13
 -----------------------------------------------------------------
 05 | 16/05 | 15/05 | 11/05 | 06/05 | 10/05 | 04/05 | 03/05 | 13/05 |
 -----------------------------------------------------------------
 02 | 16/02 | 15/02 | 11/02 | 06/02 | 10/02 | 04/02 | 03/02 | 13/02 |
 -----------------------------------------------------------------
 07 | 16/07 | 15/07 | 11/07 | 06/07 | 10/07 | 04/07 | 03/07 | 13/07 |
 -----------------------------------------------------------------
 01 | 16/01 | 15/01 | 11/01 | 06/01 | 10/01 | 04/01 | 03/01 | 13/01 |
 -----------------------------------------------------------------
 12 | 16/12 | 15/12 | 11/12 | 06/12 | 10/12 | 04/12 | 03/12 | 13/12 |
 -----------------------------------------------------------------
 08 | 16/08 | 15/08 | 11/08 | 06/08 | 10/08 | 04/08 | 03/08 | 13/08 |
 -----------------------------------------------------------------
 14 | 16/14 | 15/14 | 11/14 | 06/14 | 10/14 | 04/14 | 03/14 | 13/14 |
 -----------------------------------------------------------------
 09 | 16/09 | 15/09 | 11/09 | 06/09 | 10/09 | 04/09 | 03/09 | 13/09 |
 -----------------------------------------------------------------
 */

/*
bits | output
 -------------
 000  | 0000 0001
 001  | 0000 0011
 010  | 0000 0111
 011  | 0000 1111
 100  | 0001 1111
 101  | 0011 1111
 110  | 0111 1111
 111  | 1111 1111
 */

//set up defines for wire to code

#define col1 16
#define col2 15
#define col3 11
#define col4  6
#define col5 10
#define col6  4
#define col7  3
#define col8 13

#define row1  5
#define row2  2
#define row3  7
#define row4  1
#define row5 12
#define row6  8
#define row7 14
#define row8  9

// set up ascii table for use
//          pin 7-0 , pin 13-8
int a[] = {
  B11011100,B101111};


void setup() {

  Serial.begin(9600);

  // put your setup code here, to run once:
  //set up pins 0-7 
  DDRD |= B11111100;
  //set up pins 8-13
  DDRB |= B00111111;

  int i = 2;

  for(;i < 14; i++){
    digitalWrite(i,HIGH);
  }

  digitalWrite(10,LOW);
}

void resetBoard(){
  //set all pins high so no leds are glowing
  PORTD |= B11111100;
  PORTB |= B00111111;
}

void loop() {
  // put your main code here, to run repeatedly:
  Serial.println("It works!?");
  for(int j = 10; j < 14; j++)
  {
    digitalWrite(j,LOW);
    for(int i = 2; i < 10; i++)
    {
      digitalWrite(i,LOW);
      delay(250);
      digitalWrite(i,HIGH);
      delay(250);
    }
    digitalWrite(j,HIGH);
  }


}

//  // 1st led
////  PORTD |= B00000000;
////  PORTB |= B00000000;
//  digitalWrite(2,LOW);
//  delay(250);
//
////  PORTD |= B00000100;
////  PORTB |= B00000000; 
//  digitalWrite(2,HIGH);
//  delay(250);



